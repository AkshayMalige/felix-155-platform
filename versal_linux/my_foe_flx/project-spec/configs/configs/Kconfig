## versal_linux/my_foe_flx/project-spec/configs/configs/Kconfig
```kconfig
mainmenu "PetaLinux System Configuration"
config SUBSYSTEM_TYPE_LINUX
        bool
        default y
        select SYSTEM_VERSAL

config SYSTEM_VERSAL
        bool "VERSAL Configuration"
        help
          VERSAL Configuration for the project.
          All these config options will be in /home/synthara/VersalPrjs/felix/AM_felix2101/felix-155-xpfm/felix-155-platform/versal_linux/my_foe_flx/project-spec/configs/config

config SUBSYSTEM_VARIANT_VERSALPREMIUM
        bool
        default y
        help

config SUBSYSTEM_DISTRO_PETALINUX
        bool
        default y
        help

source /home/synthara/VersalPrjs/felix/AM_felix2101/felix-155-xpfm/felix-155-platform/versal_linux/my_foe_flx/project-spec/configs/configs/Kconfig.main
```
